## sdkconfig.defaults.esp32p4
```kconfig
# ESP32-P4 specific configuration - ESP-IDF 6.0
# P4 has no built-in WiFi; uses ESP-Hosted via C6 coprocessor.
# P4 uses a high-speed MSPI PSRAM controller; SPIRAM_MODE_QUAD/OCT
# do not apply. IDF auto-detects PSRAM geometry on this chip.
CONFIG_SPIRAM=y
CONFIG_SPIRAM_BOOT_INIT=y
CONFIG_SPIRAM_USE_MALLOC=y
CONFIG_SPIRAM_MALLOC_ALWAYSINTERNAL=16384
CONFIG_SPIRAM_MALLOC_RESERVE_INTERNAL=32768
CONFIG_ESPTOOLPY_FLASHMODE_QIO=y
CONFIG_ESPTOOLPY_FLASHSIZE_32MB=y
CONFIG_PARTITION_TABLE_OFFSET=0x10000
CONFIG_COMPILER_OPTIMIZATION_PERF=y
CONFIG_SPIRAM_SPEED_200M=y
CONFIG_CACHE_L2_CACHE_256KB=y
CONFIG_CACHE_L2_CACHE_LINE_128B=y
CONFIG_ESP_SYSTEM_ALLOW_RTC_FAST_MEM_AS_HEAP=n
CONFIG_ESP_TASK_WDT_TIMEOUT_S=40
CONFIG_FATFS_LFN_HEAP=y
CONFIG_FREERTOS_VTASKLIST_INCLUDE_COREID=y
CONFIG_FREERTOS_GENERATE_RUN_TIME_STATS=y
CONFIG_MBEDTLS_HKDF_C=y
CONFIG_BSP_SD_FORMAT_ON_MOUNT_FAIL=y
CONFIG_ESP_DEFAULT_CPU_FREQ_MHZ_360=y
CONFIG_ESP_DEFAULT_CPU_FREQ_MHZ=360
CONFIG_ESP_MAIN_TASK_STACK_SIZE=8192
# WiFi via co-processor (esp_wifi_remote) - ESP32-P4 has no native WiFi.
# espressif/esp_wifi_remote managed component is added to idf_component.yml.
# Selects ESP32-C6 as WiFi co-processor (default for P4-Function-EV-Board).
CONFIG_SLAVE_IDF_TARGET_ESP32C6=y
CONFIG_ESP32P4_SELECTS_REV_LESS_V3=y
```
